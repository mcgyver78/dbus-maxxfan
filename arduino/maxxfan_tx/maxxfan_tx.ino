/*
 * maxxfan_tx - infrared transmitter for the MaxxAir MaxxFan Deluxe.
 *
 * Computes the remote control packet from the requested state instead of
 * replaying recorded pulse trains, so every combination the fan understands
 * can be sent - including the thermostat setpoint, which fixed-signal
 * sketches cannot reach.
 *
 * Wiring: infrared LED on pin 9 (OC1A) through a current limiting resistor,
 * cathode to ground. Pin 9 is not a free choice: the 38 kHz carrier is
 * generated by timer 1 in hardware, which leaves the serial port and millis()
 * working while a packet is on the air.
 *
 * Serial protocol, 115200 8N1, one command per line:
 *
 *   ?                                              -> MAXXFAN 1
 *   S <on> <speed> <exhaust> <cover> <auto> <degF> <warn>  -> OK <32 hex digits>
 *   R                                              -> OK <32 hex digits>
 *
 *   on       0 = off, 1 = on
 *   speed    0, 10, 20 ... 100 percent
 *   exhaust  0 = intake, 1 = exhaust
 *   cover    0 = closed, 1 = open
 *   auto     0 = manual, 1 = thermostat
 *   degF     thermostat setpoint, 29..99 degrees Fahrenheit (the fan's own unit)
 *   warn     1 = make the fan beep twice
 *
 * Anything else answers ERR. R repeats the last packet unchanged.
 *
 * Board: Arduino Nano / Uno / Pro Mini (ATmega328P). MIT licence.
 */

#if !defined(__AVR_ATmega328P__) && !defined(__AVR_ATmega168__)
#error "This sketch drives timer 1 directly and needs an ATmega328P board (classic Nano, Uno, Pro Mini)."
#endif

#define IR_PIN 9              /* OC1A - fixed by the hardware timer */

/* Measured from the original remote: 99 captured signals average 834 us per
 * symbol, not the 800 us often quoted. The fan accepts both, but matching the
 * remote leaves the widest margin on a weak or off-axis path. */
static const uint16_t SYMBOL_US = 834;

static const uint8_t PREAMBLE[10] = {
  0x5A, 0xA5, 0x80, 0x7F, 0x40, 0xBF, 0x20, 0xDF, 0x10, 0xCC
};

static uint8_t packet[16];
static bool have_packet = false;

/* ------------------------------------------------------------------ carrier */

static void carrier_init()
{
  pinMode(IR_PIN, OUTPUT);
  digitalWrite(IR_PIN, LOW);
  TCCR1A = 0;
  TCCR1B = 0;
  ICR1  = (F_CPU / 38000UL) - 1;      /* 420 at 16 MHz -> 38.0 kHz */
  OCR1A = (ICR1 + 1) / 3;             /* one third duty, as the remote uses */
  TCCR1A = _BV(WGM11);                          /* fast PWM, TOP = ICR1 */
  TCCR1B = _BV(WGM13) | _BV(WGM12) | _BV(CS10); /* no prescaler */
}

static inline void carrier_on()  { TCCR1A |= _BV(COM1A1); }
static inline void carrier_off() { TCCR1A &= ~_BV(COM1A1); PORTB &= ~_BV(PB1); }

/* --------------------------------------------------------------- modulation */

/* Symbols of equal level are merged into one run, so the carrier is switched
 * only where the signal actually changes. Timing is measured from the start of
 * the packet rather than symbol by symbol, so the small delay of each switch
 * does not accumulate over the 176 symbols of a packet. */
static uint32_t tx_start, tx_deadline;
static bool tx_level;
static uint16_t tx_run;

static void tx_flush()
{
  if (tx_run == 0)
    return;
  if (tx_level)
    carrier_on();
  else
    carrier_off();
  tx_deadline += (uint32_t)tx_run * SYMBOL_US;
  while ((uint32_t)(micros() - tx_start) < tx_deadline)
    ;
  tx_run = 0;
}

static void tx_put(bool mark, uint8_t count)
{
  if (tx_run != 0 && mark != tx_level)
    tx_flush();
  tx_level = mark;
  tx_run += count;
}

static void send_packet()
{
  tx_start = micros();
  tx_deadline = 0;
  tx_run = 0;
  tx_level = false;

  for (uint8_t i = 0; i < 16; i++) {
    uint8_t b = packet[i];
    tx_put(true, 1);                  /* start bit is a zero, and zero is a mark */
    for (uint8_t j = 0; j < 8; j++) { /* data bits, least significant first */
      tx_put((b & 1) == 0, 1);
      b >>= 1;
    }
    tx_put(false, 2);                 /* two stop bits */
  }
  tx_put(false, 8);                   /* end of transmission */
  tx_flush();
  carrier_off();
}

/* ------------------------------------------------------------------- packet */

static bool build_packet(int on, int speed, int exhaust, int cover,
                         int automode, int degf, int warn)
{
  if (on < 0 || on > 1 || exhaust < 0 || exhaust > 1 || cover < 0 || cover > 1 ||
      automode < 0 || automode > 1 || warn < 0 || warn > 1)
    return false;
  if (speed < 0 || speed > 100 || (speed % 10) != 0)
    return false;
  if (degf < 29 || degf > 99)
    return false;

  /* The special bit overrides the fan's own coupling of cover and fan. It is
   * set in thermostat mode, and for ceiling fan mode - running with the cover
   * closed - which the fan otherwise refuses. */
  bool special = automode || (on && !cover);

  memcpy(packet, PREAMBLE, sizeof(PREAMBLE));
  packet[10] = (on ? 0x01 : 0) | (special ? 0x02 : 0) | (exhaust ? 0x04 : 0) |
               (cover ? 0x08 : 0) | (automode ? 0x10 : 0) | (warn ? 0x20 : 0);
  packet[11] = (uint8_t)speed;
  packet[12] = (uint8_t)degf;
  packet[13] = 0xFF;
  packet[14] = 0x23;
  packet[15] = packet[10] ^ packet[11] ^ packet[12] ^ packet[13] ^ packet[14];
  have_packet = true;
  return true;
}

static void print_packet()
{
  Serial.print(F("OK "));
  for (uint8_t i = 0; i < 16; i++) {
    if (packet[i] < 0x10)
      Serial.print('0');
    Serial.print(packet[i], HEX);
  }
  Serial.println();
}

/* -------------------------------------------------------------------- lines */

static char line[64];
static uint8_t fill;

static void handle(char *s)
{
  if (s[0] == '?' && s[1] == 0) {
    Serial.println(F("MAXXFAN 1"));
    return;
  }
  if (s[0] == 'R' && s[1] == 0) {
    if (!have_packet) {
      Serial.println(F("ERR nothing sent yet"));
      return;
    }
    send_packet();
    print_packet();
    return;
  }
  if (s[0] == 'S') {
    int v[7];
    uint8_t n = 0;
    char *tok = strtok(s + 1, " \t");
    while (tok != NULL && n < 7) {
      v[n++] = atoi(tok);
      tok = strtok(NULL, " \t");
    }
    if (n != 7 || tok != NULL) {
      Serial.println(F("ERR expected 7 values"));
      return;
    }
    if (!build_packet(v[0], v[1], v[2], v[3], v[4], v[5], v[6])) {
      Serial.println(F("ERR value out of range"));
      return;
    }
    send_packet();
    print_packet();
    return;
  }
  Serial.println(F("ERR unknown command"));
}

void setup()
{
  Serial.begin(115200);
  carrier_init();
  Serial.println(F("MAXXFAN 1"));
}

void loop()
{
  while (Serial.available()) {
    char c = Serial.read();
    if (c == '\r')
      continue;
    if (c == '\n') {
      line[fill] = 0;
      if (fill > 0)
        handle(line);
      fill = 0;
      continue;
    }
    if (fill < sizeof(line) - 1)
      line[fill++] = c;
    else
      fill = 0;                       /* overlong line, drop it */
  }
}
